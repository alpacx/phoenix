## benchmarks/crypto/sdkconfig.defaults
```kconfig
CONFIG_IDF_TARGET="esp32p4"
CONFIG_ESP32P4_SELECTS_REV_LESS_V3=n
CONFIG_ESP32P4_REV_MIN_300=y
CONFIG_ESPTOOLPY_FLASHSIZE_16MB=y
CONFIG_COMPILER_OPTIMIZATION_PERF=y
CONFIG_ESP_MAIN_TASK_STACK_SIZE=8192
```

## main/Kconfig.projbuild
```kconfig
menu "Phoenix"
config PHOENIX_USB_LAB
 bool "Enable USB device after electrical fixture verification"
 default n
 help
  Requires verified isolation of board VBUS source from host VBUS and
  a suitable VBUS sensing circuit. See docs/HARDWARE.md.
config PHOENIX_VBUS_GPIO
 int "Verified host VBUS sense GPIO (-1 = not wired)"
 range -1 54
 default -1
config PHOENIX_C6_PROBE
 bool "Probe C6 firmware and scan Wi-Fi once (no connection)"
 default n
endmenu
```

## sdkconfig.defaults
```kconfig
CONFIG_IDF_TARGET="esp32p4"
CONFIG_ESPTOOLPY_FLASHSIZE_16MB=y
CONFIG_ESP32P4_SELECTS_REV_LESS_V3=y
CONFIG_ESP32P4_REV_MIN_100=y
CONFIG_ETH_USE_ESP32_EMAC=y
CONFIG_LWIP_IPV6=n
CONFIG_LWIP_IP_FORWARD=y
CONFIG_LWIP_IPV4_NAPT=y
CONFIG_LWIP_TCPIP_CORE_LOCKING=y
CONFIG_COMPILER_OPTIMIZATION_PERF=y
CONFIG_ESP_CONSOLE_UART_DEFAULT=y
CONFIG_PARTITION_TABLE_CUSTOM=y
CONFIG_PARTITION_TABLE_CUSTOM_FILENAME="partitions.csv"
CONFIG_BOOTLOADER_APP_ROLLBACK_ENABLE=y
CONFIG_TINYUSB_NET_MODE_NCM=y
CONFIG_ESP_HOSTED_AUTO_CALL_INIT_BEFORE_APP_MAIN=n
CONFIG_ESP_HOSTED_HOST_RESET_GPIO=54
CONFIG_ESP_HOSTED_HOST_SDIO_CLK_KHZ=20000
CONFIG_ESP_HOSTED_HOST_SDIO_PIN_CLK=18
CONFIG_ESP_HOSTED_HOST_SDIO_PIN_CMD=19
CONFIG_ESP_HOSTED_HOST_SDIO_PIN_D0=14
CONFIG_ESP_HOSTED_HOST_SDIO_PIN_D1=15
CONFIG_ESP_HOSTED_HOST_SDIO_PIN_D2=16
CONFIG_ESP_HOSTED_HOST_SDIO_PIN_D3=17
CONFIG_LWIP_TCPIP_TASK_STACK_SIZE=8192
CONFIG_LWIP_CHECKSUM_CHECK_IP=y
CONFIG_LWIP_CHECKSUM_CHECK_UDP=y
CONFIG_LWIP_IPV4_NAPT_PORTMAP=n
CONFIG_ESP_HOSTED_HOST_TRANSPORT_RESTART_ON_FAILURE=n
```
